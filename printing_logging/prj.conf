## CMakeLists.txt
```
cmake_minimum_required(VERSION 3.20.0)
find_package(Zephyr REQUIRED HINTS $ENV{ZEPHYR_BASE})

project(printing_logging)

target_sources(app PRIVATE src/main.c)

if(CONFIG_SUM_PRINT)
  target_sources(app PRIVATE sum_printk/sum_printk.c)
  target_include_directories(app PRIVATE sum_printk)
elseif(CONFIG_SUM_LOG)
  target_sources(app PRIVATE sum_log/sum_log.c)
  target_include_directories(app PRIVATE sum_log)
endif()
```

## Kconfig
```
# Needed to include Zephyr's CONFIG_LOG, CONFIG_UART_CONSOLE, etc. for prj.conf
source "Kconfig.zephyr"

choice SUM_IMPL
	prompt "Sum implementation"
	default SUM_PRINT

config SUM_PRINT
	bool "Print sum() result with printk()"

config SUM_LOG
	bool "Print sum() result with the logger"
	select LOG

endchoice
```

## prj.conf
```kconfig
# Console output for sum_printk() / sum_log()
CONFIG_CONSOLE=y
CONFIG_UART_CONSOLE=y

# Used when CONFIG_SUM_LOG is selected (sets its default verbosity to INFO)
CONFIG_LOG_DEFAULT_LEVEL=3
```

## src/main.c
```c
#include <zephyr/kernel.h>

#ifdef CONFIG_SUM_PRINT
#include "sum_printk.h"
#elif defined(CONFIG_SUM_LOG)
#include "sum_log.h"
#endif

int main(void)
{
#ifdef CONFIG_SUM_PRINT
	sum_printk(3, 5);
#elif defined(CONFIG_SUM_LOG)
	sum_log(3, 5);
#endif

	return 0;
}
```
