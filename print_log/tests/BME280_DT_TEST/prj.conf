## CMakeLists.txt
```
cmake_minimum_required(VERSION 3.20.0)

# Reuse the app's board overlay so the bme280/i2c1 devicetree nodes we're
# sanity-checking actually exist for this build.
set(DTC_OVERLAY_FILE ${CMAKE_CURRENT_SOURCE_DIR}/../../boards/nrf7002dk_nrf5340_cpuapp_ns.overlay)

find_package(Zephyr REQUIRED HINTS $ENV{ZEPHYR_BASE})

project(bme280_dt_test)

target_sources(app PRIVATE
  src/bme280_dt_test.c
  ${CMAKE_CURRENT_SOURCE_DIR}/../../bme280_temp/bme280_temp.c
)

target_include_directories(app PRIVATE ${CMAKE_CURRENT_SOURCE_DIR}/../../bme280_temp)
```

## Kconfig
```
# Needed so Zephyr's own options (CONFIG_ZTEST, CONFIG_I2C, etc.) are visible to this test's prj.conf
source "Kconfig.zephyr"
```

## prj.conf
```kconfig
CONFIG_ZTEST=y
CONFIG_ZTEST_ASSERT_VERBOSE=2

CONFIG_I2C=y
CONFIG_CBPRINTF_FP_SUPPORT=y

# Frees the TWIM1/I2C1 hardware block (shared with UARTE1) for non-secure
# use -- see print_log/prj.conf for the full explanation.
CONFIG_TFM_LOG_LEVEL_SILENCE=y
```

## src/bme280_dt_test.c
```c
#include <zephyr/ztest.h>
#include <zephyr/devicetree.h>
#include "bme280_temp.h"

/*
 * 8.2: sanity-check that the BME280 devicetree node is set up correctly.
 * No physical BME280 is attached during this test, so these checks only
 * touch devicetree metadata and the I2C1 bus controller's own init state
 * -- never a real sensor register.
 */

ZTEST(bme280_dt_test_suite, test_bme280_node_enabled)
{
	zassert_true(DT_NODE_HAS_STATUS(DT_NODELABEL(bme280), okay),
		     "bme280 devicetree node is missing or not status = \"okay\"");
}

ZTEST(bme280_dt_test_suite, test_bme280_compatible)
{
	zassert_true(DT_NODE_HAS_COMPAT(DT_NODELABEL(bme280), i2c_device),
		     "bme280 node compatible should be \"i2c-device\"");
}

ZTEST(bme280_dt_test_suite, test_bme280_i2c_address)
{
	zassert_equal(DT_REG_ADDR(DT_NODELABEL(bme280)), 0x77,
		      "bme280 I2C address should be 0x77");
}

ZTEST(bme280_dt_test_suite, test_bme280_i2c_bus_ready)
{
	zassert_true(device_is_ready(bme280.bus),
		     "i2c1 bus controller for the bme280 node is not ready");
}

/*
 * No physical sensor is attached, so instead of reading real calibration
 * and ADC registers, these feed known values straight into the pure
 * compensation function to sanity-check its math.
 */
ZTEST(bme280_dt_test_suite, test_compensate_temperature_zero_coeffs)
{
	int32_t t_fine;
	int32_t temperature = bme280_compensate_temperature(519888, 27504, 0, 0, &t_fine);

	zassert_equal(t_fine, 0, "t_fine should be 0 when dig_T2 and dig_T3 are 0");
	zassert_equal(temperature, 0, "temperature should be 0 when dig_T2 and dig_T3 are 0");
}

ZTEST(bme280_dt_test_suite, test_compensate_temperature_known_value)
{
	int32_t t_fine;
	int32_t temperature = bme280_compensate_temperature(800, 0, 2048, 0, &t_fine);

	zassert_equal(t_fine, 100, "t_fine mismatch for known mocked calibration values");
	zassert_equal(temperature, 2, "temperature mismatch for known mocked calibration values");
}

ZTEST_SUITE(bme280_dt_test_suite, NULL, NULL, NULL, NULL, NULL);
```
